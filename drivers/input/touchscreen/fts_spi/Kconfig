## drivers/input/touchscreen/fts_spi/Kconfig
```kconfig
config TOUCHSCREEN_ST_FTS_V521_SPI
	tristate "ST FTS V521 I2C Touchscreen"
	depends on I2C
	help
	  Say Y here if you have ST FTS series I2C touchscreen.

	  If unsure, say N.

	  To compile this driver as a module, choose M here: the
	  module will be called fts_touch_spi.

config TOUCHSCREEN_FOD
	tristate "FTS FOD area report"
	depends on TOUCHSCREEN_ST_FTS_V521_SPI
	help
          Say Y here to enable fod area report functionality.

          If unsure, say N.

config TOUCHSCREEN_ST_DEBUG_FS
	tristate "St core driver module"
	depends on TOUCHSCREEN_ST_FTS_V521_SPI
	help
          Say Y here to enable touch debugfs functionality.

          If unsure, say N.
```

## drivers/mihw/Kconfig
```kconfig
config MILLET_CGROUP
	tristate "frozen framework cgroup"
	depends on MIHW
	default n
	help
	  Mi frozen function

config MILLET_SIG
	tristate "frozen framework signal"
	depends on MIHW
	default n
	help
	  Mi frozen function

config MILLET_BINDER
	tristate "frozen framework binder"
	depends on MIHW
	default n
	help
	  Mi frozen function

config MILLET_PKG
	tristate "frozen framework pkg"
	depends on MIHW
	default n
	help
	  Mi frozen function

config MILLET_BINDER_GKI
	tristate "frozen framework binder gki"
	depends on MIHW
	default n
	help
	  Mi frozen function

config MILLET_CORE
	tristate "frozen framework core"
	depends on MIHW
	default n
	help
	  Mi frozen function

config MILLET_HS
	tristate "frozen framework hs"
	depends on MIHW
	default n
	help
	  Mi frozen function
```
