## drivers/platform/xiaomi/Kconfig
```kconfig
# Xiaomi configuration options

config MACH_XIAOMI
	bool "Xiaomi device"
	depends on ARCH_QCOM
	help
	  Support for Xiaomi products

config MACH_XIAOMI_SM8250
	bool "Xiaomi SM8250"
	depends on ARCH_QCOM
	select MACH_XIAOMI
	select BOARD_XIAOMI
	help
	  Support for Xiaomi SM8250 devices

menu "Xiaomi board selection"

	config MACH_XIAOMI_ALIOTH
		bool "Xiaomi alioth board"
		select MACH_XIAOMI_SM8250
		select BOARD_ALIOTH
		help
		  Support for Redmi K40 / POCO F3 / Mi 11X

	config MACH_XIAOMI_APOLLO
		bool "Xiaomi apollo board"
		select MACH_XIAOMI_SM8250
		select BOARD_APOLLO
		help
		  Support for Mi 10T / Mi 10T Pro / Redmi K30S Ultra

	config MACH_XIAOMI_CAS
		bool "Xiaomi cas board"
		select MACH_XIAOMI_SM8250
		select BOARD_CAS
		help
		  Support for Mi 10 Ultra

	config MACH_XIAOMI_CMI
		bool "Xiaomi cmi board"
		select MACH_XIAOMI_SM8250
		select BOARD_CMI
		help
		  Support for Mi 10 Pro

	config MACH_XIAOMI_DAGU
		bool "Xiaomi dagu board"
		select MACH_XIAOMI_SM8250
		select BOARD_DAGU
		help
		  Support for Xiaomi Pad 5 Pro 12.4

	config MACH_XIAOMI_ELISH
		bool "Xiaomi elish board"
		select MACH_XIAOMI_SM8250
		select BOARD_ELISH
		help
		  Support for Xiaomi Pad 5 Pro Wi-Fi

	config MACH_XIAOMI_ENUMA
		bool "Xiaomi enuma board"
		select MACH_XIAOMI_SM8250
		select BOARD_ENUMA
		help
		  Support for Xiaomi Pad 5 Pro 5G

	config MACH_XIAOMI_LMI
		bool "Xiaomi lmi board"
		select MACH_XIAOMI_SM8250
		select BOARD_LMI
		help
		  Support for Redmi K30 Pro / POCO F2 Pro

	config MACH_XIAOMI_MUNCH
		bool "Xiaomi munch board"
		select MACH_XIAOMI_SM8250
		select BOARD_MUNCH
		help
		  Support for Redmi K40S / POCO F4

	config MACH_XIAOMI_PSYCHE
		bool "Xiaomi psyche board"
		select MACH_XIAOMI_SM8250
		select BOARD_PSYCHE
		help
		  Support for Xiaomi 12X

	config MACH_XIAOMI_THYME
		bool "Xiaomi thyme board"
		select MACH_XIAOMI_SM8250
		select BOARD_THYME
		help
		  Support for Mi 10S

config MACH_XIAOMI_PIPA
		bool "Xiaomi pipa board"
		select MACH_XIAOMI_SM8250
		select BOARD_PIPA
		help
		  Support for Pad 6

	config MACH_XIAOMI_UMI
		bool "Xiaomi umi board"
		select MACH_XIAOMI_SM8250
		select BOARD_UMI
		help
		  Support for Mi 10

endmenu
```

## drivers/power/supply/maxim/Kconfig
```kconfig
config BATT_VERIFY_BY_DS28E16
	bool
	prompt "Support ds28e16 as encryption IC."
	default n
	help
		It needs a onewire physical controller to work.

config DS28E16_CYCLE_PAGE1
	bool
	prompt "Store battery cycle count in DS28E16 Page 1"
	depends on BATT_VERIFY_BY_DS28E16
	default n
	help
		Store battery cycle count in Page 1 EEPROM instead of Page 2 decrement counter.

config ONEWIRE_GPIO
	bool
	prompt "Support Onewire Driver."
	default n
	help
		It's an onewire driver.
```
